## OS_linux/meta-cas/conf/distro/cas.conf
```bitbake
require conf/distro/poky.conf

DISTRO_FEATURES_append = " systemd bluetooth bluez5"
VIRTUAL-RUNTIME_init_manager = "systemd"

DISTRO_FEATURES_BACKFILL_CONSIDERED = "sysvinit"

VIRTUAL-RUNTIME_initscripts = ""

KERNEL_MODULE_AUTOLOAD_append = " bcm2835-v4l2"
```
